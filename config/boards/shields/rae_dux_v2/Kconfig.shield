## config/boards/shields/rae_dux_v2/Kconfig.shield
```kconfig
# Copyright (c) 2022 The ZMK Contributors
# SPDX-License-Identifier: MIT

config SHIELD_RAE_DUX_V2_LEFT
	def_bool $(shields_list_contains,rae_dux_v2_left)

config SHIELD_RAE_DUX_V2_RIGHT
	def_bool $(shields_list_contains,rae_dux_v2_right)
```

## config/west.yml
```yaml
manifest:
  remotes:
    - name: zmkfirmware
      url-base: https://github.com/zmkfirmware
    - name: andrewjrae
      url-base: https://github.com/andrewjrae
  projects:
    - name: zmk
      remote: andrewjrae
      revision: andrewjrae
      import: app/west.yml
  self:
    path: config
```
